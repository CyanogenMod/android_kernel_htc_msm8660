## drivers/media/video/msm_ds/Kconfig
```kconfig
comment "Qualcomm MSM Camera And Video"

menuconfig DS_MSM_CAMERA
	bool "Qualcomm MSM camera and video capture support"
	depends on ARCH_MSM
	help
	  Say Y here to enable selecting the video adapters for
	  Qualcomm msm camera and video encoding

config DS_MSM_CAMERA_V4L2
	bool "Video For Linux interface to MSM camera"
	depends on DS_MSM_CAMERA && VIDEO_V4L2 && EXPERIMENTAL
	default y
	help
	  Say Y here to enable the V4L2 interface for the MSM camera.
	  Not everything works through this interface and it has not
	  been thoroughly tested.

choice
        prompt "Qualcomm MSM camera and video capture support"
	depends on DS_MSM_CAMERA
        default MSM_CAMERA_LEGACY

        config DS_MSM_CAMERA_LEGACY
                bool "msm camera legacy"

        config DS_MSM_CAMERA_7X30
                bool "msm camera 7x30"
        config DS_MSM_CAMERA_8X60
                bool "msm camera 8x60"

endchoice

config DS_720P_CAMERA
        bool "Qualcomm MSM camera with 720P video support"
        depends on DS_MSM_CAMERA_LEGACY
        help
          720P video support

config DS_CAMERA_ZSL
	bool "Qualcomm MSM ZSL support"
	depends on DS_MSM_CAMERA && ARCH_MSM8X60
	default n
	---help---
	  Enable support for ZSL

config DS_MSM_CAMERA_DEBUG
	bool "Qualcomm MSM camera debugging with printk"
	depends on DS_MSM_CAMERA
	help
	  Enable printk() debug for msm camera

config DS_FLASH_BACKLIGHT_OFF
	bool "Turn off backlight when flash high"
	depends on DS_MSM_CAMERA
	help
	  Turn off backlight when flash high

comment "Camera Sensor Selection"
config DS_MT9T013
	bool "Sensor mt9t013 (BAYER 3M)"
	depends on DS_MSM_CAMERA
	---help---
	  MICRON 3M Bayer Sensor with AutoFocus

config DS_MT9D112
	bool "Sensor mt9d112 (YUV 2M)"
	depends on DS_MSM_CAMERA
	---help---
	  MICRON 2M YUV Sensor


config DS_IMX105
	bool "Sensor IMX105 8MP MIPI (BAYER 8M)"
	depends on DS_MSM_CAMERA && ARCH_MSM8X60
	default n
	---help---
	SONY 8M Bayer MIPI Sensor with Autofocus

config DS_MT9P012
	bool "Sensor mt9p012 (BAYER 5M)"
	depends on DS_MSM_CAMERA
	---help---
	  MICRON 5M Bayer Sensor with Autofocus

config DS_MSM_CAMERA_AF_FOXCONN
	bool "FOXCONN Module"
	depends on DS_MT9P012
	---help---
	  This driver supports FOXCONN AF module for 5M Bayer sensor
config DS_S5K3E2FX
	bool "Sensor s5k3e2fx (Samsung 5M)"
	depends on DS_MSM_CAMERA
	---help---
	  Samsung 5M with Autofocus

config DS_S5K4E1GX
	bool "Sensor s5k4e1gx (Samsung 5M)"
	depends on DS_MSM_CAMERA
	default n
	---help---
	  Samsung 5M with Autofocus

config DS_S5K4E5YX
        bool "Sensor s5k4e5yx (Samsung 5M)"
        depends on DS_MSM_CAMERA
        default n
        ---help---
          Samsung 5M with Autofocus

config DS_S5K6AAFX
	bool "Sensor s5k6aafx (Samsung 1.3M)"
	depends on DS_MSM_CAMERA
	default n
	---help---
	  Samsung 1.3M without Autofocus

config DS_OV8810
	bool "Sensor ov8810"
	depends on DS_MSM_CAMERA
	default n
	---help---
	  OmniVision 8M Bayer Sensor

config DS_OV8830
	bool "Sensor ov8830"
	depends on DS_MSM_CAMERA
	default n
	---help---
	  OmniVision 8M Bayer Sensor

config DS_OV9665
	bool "Sensor ov9665"
	depends on DS_MSM_CAMERA
	default n
	---help---
	  OmniVision 3M YUV Sensor

config DS_MSM_CAMERA_FLASH
	bool "Qualcomm MSM camera flash support"
	depends on DS_MSM_CAMERA_8X60
	default y
	---help---
	  Enable support for LED flash for msm camera

config DS_S5K3H1GX
        bool "Sensor s5k3h1gx"
        depends on DS_MSM_CAMERA
        default n
        ---help---
          Samsung 8M 3H1 MIPI AF Sensor

config DS_S5K3H2YX
	bool "Sensor s5k3h2yx"
	depends on DS_MSM_CAMERA
	default n
	---help---
	  Samsung 8M 3H2 MIPI AF Sensor

config DS_MSM_GEMINI
	bool "Qualcomm MSM Gemini Jpeg Engine support"
	depends on DS_MSM_CAMERA && (ARCH_MSM7X30 || ARCH_MSM8X60)
	default n
	---help---
	  Enable support for Gemini Jpeg Engine

config DS_MSM_VPE
	tristate "Qualcomm MSM Video Pre-processing Engine support"
	depends on DS_MSM_CAMERA && (ARCH_MSM7X30 || ARCH_MSM8X60)
	default y
	---help---
	  Enable support for Video Pre-processing Engine

config DS_MT9V113
	bool "Sensor mt9v113"
	depends on DS_MSM_CAMERA
	default n
	---help---
	  MICRON VGA YUV Sensor

config DS_SP3D
	bool "Sensor SP3D (Sharp 3D module)"
	depends on DS_MSM_CAMERA && ARCH_MSM8X60
	default n
	---help---
	SHARP 3D Module

config DS_MT9D015
	bool "Sensor mt9d015 (Aptina 2M)"
	depends on DS_MSM_CAMERA && ARCH_MSM8X60 && !DS_MSM_CAMERA_V4L2
	default n
	---help---
	  Aptina 2M with Autofocus
```

## drivers/net/wireless/bcmdhd_ds/Kconfig
```kconfig
config BCMDHD_DS
	tristate "Broadcom 4329/30 wireless cards support (legacy for doubleshot)"
	depends on MMC
	---help---
	  This module adds support for wireless adapters based on
	  Broadcom 4329/30 chipset. Legacy unpatched version which works
	  best on htc doubeshot (not getting stuck on dropouts).

	  This driver uses the kernel's wireless extensions subsystem.

	  If you choose to build a module, it'll be called dhd. Say M if
	  unsure.

config BCMDHD_DS_FW_PATH
	depends on BCMDHD_DS
	string "Firmware path"
	default "/system/etc/firmware/fw_bcmdhd.bin"
	---help---
	  Path to the firmware file.

config BCMDHD_DS_NVRAM_PATH
	depends on BCMDHD_DS
	string "NVRAM path"
	default "/system/etc/wifi/bcmdhd.cal"
	---help---
	  Path to the calibration file.

config BCMDHD_DS_WEXT
	bool "Enable WEXT support"
	depends on BCMDHD_DS && CFG80211 = n
	select WIRELESS_EXT
	select WEXT_PRIV
	help
	  Enables WEXT support
```
